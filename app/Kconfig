## app/Kconfig
```kconfig
source "${ZEPHYR_BASE}/Kconfig"

menu "LED Subsystem"

choice LED_BLINK_SLEEP_TIME
    prompt "LED blink sleep time"
    default LED_SLEEP_1S

config LED_SLEEP_250MS
    bool "250ms (fast)"

config LED_SLEEP_1S
    bool "1s (medium)"

config LED_SLEEP_2S
    bool "2s (slow)"

endchoice

menuconfig LED_ADVANCED
    bool "Advanced LED settings"
    default n

if LED_ADVANCED

config LED_BRIGHTNESS
    int "LED brightness (0-100)"
    range 0 100
    default 100

config LED_FADE_DURATION
    int "LED fade duration (ms)"
    range 0 10000
    default 500

menu "Expert settings"

config LED_DEBUG
    bool "Enable LED debugging"
    default n

config LED_CUSTOM_PATTERN
    bool "Custom blink pattern"
    default n

endmenu

endif

endmenu
```

## boards/iomico/our_board/board.yml
```yaml
board:
  name: our_board
  full_name: IOMICO Our Board
  vendor: iomico
  socs:
    - name: mcxc444
```

## boards/iomico/our_board_scratch/Kconfig.our_board_scratch
```kconfig
config BOARD_OUR_BOARD_SCRATCH
	select SOC_MCXC444
	select SOC_PART_NUMBER_MCXC444VLH
```

## boards/iomico/our_board_scratch/board.yml
```yaml
board:
  name: our_board_scratch
  full_name: IOMICO Our Board Scratch
  vendor: iomico
  socs:
    - name: mcxc444
```
